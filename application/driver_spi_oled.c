#include "board.h"
#include <stdio.h>
#include <string.h>

#include "driver_spi_oled.h"

/**************************************** 8*16 ************************************/
static const unsigned char FONT8X16[]=	  
{
  0x00,0x00,0x00,0x00,0x00,0x00,0x00,0x00,0x00,0x00,0x00,0x00,0x00,0x00,0x00,0x00,// 0
  0x00,0x00,0x00,0xF8,0x00,0x00,0x00,0x00,0x00,0x00,0x00,0x33,0x30,0x00,0x00,0x00,//! 1
  0x00,0x10,0x0C,0x06,0x10,0x0C,0x06,0x00,0x00,0x00,0x00,0x00,0x00,0x00,0x00,0x00,//" 2
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  0x00,0x06,0x01,0x01,0x02,0x02,0x04,0x04,0x00,0x00,0x00,0x00,0x00,0x00,0x00,0x00,//~ 94
};

/************************************6*8************************************/
static const unsigned char FONT6x8[92][6] =		
{
    0x00, 0x00, 0x00, 0x00, 0x00, 0x00,// sp
    0x00, 0x00, 0x00, 0x2f, 0x00, 0x00,// !
    0x00, 0x00, 0x07, 0x00, 0x07, 0x00,// "
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    0x14, 0x14, 0x14, 0x14, 0x14, 0x14,// horiz lines
};


#ifdef OLED_USE_GPIO
void oled_byte_write(uint8_t data,uint8_t cmd)
{	
    uint8_t i;			  
    if(cmd)
    {
	  OLED_DC_SET();
    }
	else
    {
	  OLED_DC_CLR();
    }        
	OLED_CS_CLR();
	for(i=0; i<8; i++)
	{
		OLED_CK_CLR();
		if(data&0x80)
        {
		   OLED_MO_SET();
        }
		else
        {
		   OLED_MO_CLR();
        }
        oled_delay(20);
		OLED_CK_SET();
		data <<= 1;
        oled_delay(20);        
	}				 		  
	OLED_CS_SET();
	OLED_DC_SET();   	  
}
#endif

#ifdef OLED_USE_SPI
void oled_byte_write(uint8_t data,uint8_t cmd)
{
    if(cmd)
    {
	  OLED_DC_SET();
    }
	else
    {
	  OLED_DC_CLR();
    }        
	OLED_CS_CLR();
    while (!(Chip_SPI_GetStatus(OLED_SPI_PORT) & SPI_STAT_TXRDY)) {}; /* Make sure the last frame sent completely */
    Chip_SPI_SendMidFrame(OLED_SPI_PORT, data);
    while (!(Chip_SPI_GetStatus(OLED_SPI_PORT) & SPI_STAT_TXRDY)) {}; /* Make sure the last frame sent completely */
	OLED_CS_SET();
	OLED_DC_SET();   	  
}
#endif


void oled_set_pos(uint8_t x, uint8_t y) 
{ 
	oled_byte_write(0xb0+y, OLED_CMD);
	oled_byte_write(((x&0xf0)>>4)|0x10, OLED_CMD);
	oled_byte_write((x&0x0f)|0x01, OLED_CMD); 
}

void oled_disp_on(void)
{
	oled_byte_write(0X8D, OLED_CMD);  // SET DCDC
	oled_byte_write(0X14, OLED_CMD);  // DCDC ON
	oled_byte_write(0XAF, OLED_CMD);  // DISPLAY ON
}


void oled_display_off(void)
{
	oled_byte_write(0X8D, OLED_CMD);  // SET DCDC
	oled_byte_write(0X10, OLED_CMD);  // DCDC OFF
	oled_byte_write(0XAE, OLED_CMD);  // DISPLAY OFF
}	

void oled_disp_clr(void)  
{  
	uint8_t i,n;		    
	for(i=0;i<8;i++)  
	{  
		oled_byte_write(0xB0+i,OLED_CMD);
		oled_byte_write(0x00,OLED_CMD);
		oled_byte_write(0x10,OLED_CMD);
		for(n=0;n<128;n++)
        {
            oled_byte_write(0,OLED_DATA);
        }
	} 
}

void oled_disp_char(uint8_t x, uint8_t y, uint8_t chr)
{      	
    uint8_t c = 0, i = 0;	
    c = chr - ' ';		
    if( x > (OLED_MAX_COL-1) )
    {
        x = 0;
        y = y + 2;
    }
    if(OLED_SIZE ==16)
    {
        oled_set_pos(x,y);	
        for(i=0;i<8;i++)
        {
            oled_byte_write(FONT8X16[c*16+i],   OLED_DATA);
        }
        oled_set_pos(x,y+1);
        for(i=0;i<8;i++)
        {
            oled_byte_write(FONT8X16[c*16+i+8], OLED_DATA);
        }
    }
    else
    {	
        oled_set_pos(x,y+1);
        for(i=0;i<6;i++)
        {
            oled_byte_write(FONT6x8[c][i],      OLED_DATA);
        }
    }
}

uint32_t oled_disp_pow(uint8_t m, uint8_t n)
{
    uint32_t result=1;	 
    while(n--)
    {
        result *= m; 
    }        
    return result;
}

void oled_disp_num(uint8_t x, uint8_t y, uint32_t num, uint8_t len, uint8_t size)
{         	
	uint8_t t,temp;
	uint8_t enshow=0;						   
	for(t = 0; t < len; t++)
	{
		temp=(num/oled_disp_pow(10,len-t-1))%10;
		if(enshow==0&&t<(len-1))
		{
			if(temp==0)
			{
				oled_disp_char(x+(size/2)*t,y,' ');
				continue;
			}else enshow=1; 
		 	 
		}
	 	oled_disp_char(x+(size/2)*t,y,temp+'0'); 
	}
}

void oled_disp_string(uint8_t x,uint8_t y,uint8_t *chr)
{
	unsigned char j=0;
	while (chr[j]!='\0')
	{
        oled_disp_char(x,y,chr[j]);
        x+=8;
		if(x>120)
        {
            x=0;y+=2;
        }
        j++;
	}
}

#if 0
void oled_disp_chinese(uint8_t x,uint8_t y,uint8_t no)
{      			    
    uint8_t t,adder=0;
    oled_set_pos(x,y);	
    for(t=0;t<16;t++)
    {
        oled_byte_write(Hzk[2*no][t],OLED_DATA);
        adder+=1;
    }	
    oled_set_pos(x,y+1);	
    for(t=0;t<16;t++)
    {	
        oled_byte_write(Hzk[2*no+1][t],OLED_DATA);
        adder+=1;
    }					
}
#endif

void oled_disp_bmp(uint8_t x0, uint8_t y0,unsigned char x1, unsigned char y1,unsigned char BMP[])
{ 	
    uint8_t j=0;
    uint8_t x,y;
  
    if(y1%8==0) y=y1/8;      
    else y=y1/8+1;
    for(y=y0;y<y1;y++)
    {
        oled_set_pos(x0,y);
        for(x=x0;x<x1;x++)
        {      
            oled_byte_write(BMP[j++],OLED_DATA);	    	
        }
    }
} 

void oled_delay(uint32_t nCount)
{
    for(; nCount != 0; nCount--);
}


void oled_init(void)
{
#ifdef OLED_USE_GPIO
    // GPIO Initialized in driver_all_board.c
#endif
    
#ifdef OLED_USE_SPI
    // SPI Initialized in driver_all_board.c
#endif

    OLED_RST_SET();
	//delay_ms(100);
	oled_delay(0xffff);
	OLED_RST_CLR();
	//delay_ms(100);
	oled_delay(0xffff);
	OLED_RST_SET(); 
	oled_delay(0xffff);
    
	oled_byte_write(0xAE, OLED_CMD);//--turn off oled panel
	oled_byte_write(0x00,OLED_CMD);//---set low column address
	oled_byte_write(0x10,OLED_CMD);//---set high column address
	oled_byte_write(0x40,OLED_CMD);//--set start line address  Set Mapping RAM Display Start Line (0x00~0x3F)
	oled_byte_write(0x81,OLED_CMD);//--set contrast control register
	oled_byte_write(0xCF,OLED_CMD); // Set SEG Output Current Brightness
	oled_byte_write(0xA1,OLED_CMD);//--Set SEG/Column Mapping     0xa0???? 0xa1??
	oled_byte_write(0xC8,OLED_CMD);//Set COM/Row Scan Direction   0xc0???? 0xc8??
	oled_byte_write(0xA6,OLED_CMD);//--set normal display
	oled_byte_write(0xA8,OLED_CMD);//--set multiplex ratio(1 to 64)
	oled_byte_write(0x3f,OLED_CMD);//--1/64 duty
	oled_byte_write(0xD3,OLED_CMD);//-set display offset	Shift Mapping RAM Counter (0x00~0x3F)
	oled_byte_write(0x00,OLED_CMD);//-not offset
	oled_byte_write(0xd5,OLED_CMD);//--set display clock divide ratio/oscillator frequency
	oled_byte_write(0x80,OLED_CMD);//--set divide ratio, Set Clock as 100 Frames/Sec
	oled_byte_write(0xD9,OLED_CMD);//--set pre-charge period
	oled_byte_write(0xF1,OLED_CMD);//Set Pre-Charge as 15 Clocks & Discharge as 1 Clock
	oled_byte_write(0xDA,OLED_CMD);//--set com pins hardware configuration
	oled_byte_write(0x12,OLED_CMD);
	oled_byte_write(0xDB,OLED_CMD);//--set vcomh
	oled_byte_write(0x40,OLED_CMD);//Set VCOM Deselect Level
	oled_byte_write(0x20,OLED_CMD);//-Set Page Addressing Mode (0x00/0x01/0x02)
	oled_byte_write(0x02,OLED_CMD);//
	oled_byte_write(0x8D,OLED_CMD);//--set Charge Pump enable/disable
	oled_byte_write(0x14,OLED_CMD);//--set(0x10) disable
	oled_byte_write(0xA4,OLED_CMD);// Disable Entire Display On (0xa4/0xa5)
	oled_byte_write(0xA6,OLED_CMD);// Disable Inverse Display On (0xa6/a7) 
	oled_byte_write(0xAF,OLED_CMD);//--turn on oled panel
	
//	oled_byte_write(0xAF,OLED_CMD); /*display ON*/ 
	oled_disp_clr();
	oled_set_pos(0,0); 	
}

volatile uint8_t g_OLEDDispBuf[4][16];
void oled_task(void *line1, void *line2, void *line3, void *line4)
{
    float temperature = *(float *)line2;
    memset((char *)g_OLEDDispBuf, 0x00, sizeof(g_OLEDDispBuf));
    
    sprintf((char *)g_OLEDDispBuf[0], "  LPC845 SAKEE  ");
    sprintf((char *)g_OLEDDispBuf[1], "TEMP %3.3f", temperature);
    oled_disp_string(0, 0, (uint8_t *)g_OLEDDispBuf[0]);    
    oled_disp_string(0, 2, (uint8_t *)g_OLEDDispBuf[1]); 
    oled_disp_string(0, 4, (uint8_t *)g_OLEDDispBuf[2]); 
    oled_disp_string(0, 6, (uint8_t *)g_OLEDDispBuf[3]); 
}

// end file
